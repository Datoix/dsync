## components/audio_out/Kconfig.projbuild
```kconfig
menu "dsync audio"

    config DSYNC_AUDIO_RING_KB
        int "PCM ring buffer size (KiB)"
        default 32
        range 4 128
        help
            Ring between the A2DP data callback (producer) and the I2S writer
            task (consumer). Bigger absorbs longer network stalls; the frame is
            dropped if it overflows.

endmenu
```

## components/board/Kconfig.projbuild
```kconfig
menu "dsync board"

    config DSYNC_I2S_BCK_GPIO
        int "I2S BCK GPIO"
        default 26
        help
            Bit clock to PCM5102A. Default matches Espressif a2dp_sink example.

    config DSYNC_I2S_LRCK_GPIO
        int "I2S LRCK (WS) GPIO"
        default 22
        help
            Word select / LRCK to PCM5102A.

    config DSYNC_I2S_DOUT_GPIO
        int "I2S DOUT GPIO"
        default 25
        help
            Data out to PCM5102A DIN.

    config DSYNC_PCM5102_FMT_GPIO
        int "PCM5102A FMT GPIO"
        default 27
        help
            Format select. Firmware drives LOW = I2S (required).

    config DSYNC_PCM5102_XSMT_GPIO
        int "PCM5102A XSMT GPIO"
        default 32
        help
            Soft mute. Firmware drives HIGH = unmute.

    config DSYNC_PCM5102_DEMP_GPIO
        int "PCM5102A DEMP GPIO"
        default 33
        help
            De-emphasis. Firmware drives LOW = off.

    config DSYNC_PCM5102_FLT_GPIO
        int "PCM5102A FLT GPIO"
        default 4
        help
            FIR filter select. Firmware drives LOW = normal latency.

    config DSYNC_LED_GPIO
        int "Status LED GPIO"
        default 2
        help
            Onboard LED on ESP32 DevKit V1 (GPIO2). Remap for PCB LEDs later.

    config DSYNC_LED_ACTIVE_LEVEL
        int "Status LED active level (1=high, 0=low)"
        default 1
        range 0 1

endmenu
```

## components/bt_sink/Kconfig.projbuild
```kconfig
menu "dsync Bluetooth"

    config DSYNC_BT_DEVICE_NAME
        string "Bluetooth device name"
        default "dsync"
        help
            Name shown when pairing from a phone.

    config DSYNC_BT_SSP_ENABLED
        bool "Secure Simple Pairing"
        default y
        depends on BT_CLASSIC_ENABLED
        help
            If disabled, Bluedroid uses legacy PIN pairing (1234).

endmenu
```
